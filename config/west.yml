## config/west.yml
```yaml
manifest:
    defaults:
        revision: v0.3
    remotes:
        - name: zmkfirmware
          url-base: https://github.com/zmkfirmware
        - name: m165437 #modded nice!view display
          url-base: https://github.com/M165437
    projects:
        - name: zmk
          remote: zmkfirmware
          import: app/west.yml
        - name: nice-view-gem #modded nice!view display
          remote: m165437 #modded nice!view display
          revision: 7794ebf7f75d7e16cb05240bcffe6c5a45ef5b44 #modded nice!view display
    self:
        path: config
```
